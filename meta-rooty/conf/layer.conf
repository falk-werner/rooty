## meta-rooty/conf/layer.conf
```bitbake
# We have a conf and classes directory, add to BBPATH
BBPATH =. "${LAYERDIR}:"

# We have recipes-* directories, add to BBFILES
BBFILES += "${LAYERDIR}/recipes-*/*/*.bb \
            ${LAYERDIR}/recipes-*/*/*.bbappend"

BBFILE_COLLECTIONS += "rooty"
BBFILE_PATTERN_rooty = "^${LAYERDIR}/"
BBFILE_PRIORITY_rooty = "5"

LAYERSERIES_COMPAT_rooty = "scarthgap"

# This should only be incremented on significant changes that will
# cause compatibility issues with other layers
LAYERVERSION_rooty = "1"

LAYERDEPENDS_rooty = "core"
```
